// Copyright (c) 2022 The ZMK Contributors
// SPDX-License-Identifier: MIT

#include <behaviors.dtsi>
#include <dt-bindings/zmk/keys.h>
#include <dt-bindings/zmk/bt.h>
#include <dt-bindings/zmk/outputs.h>

// still @todo:
// - finalize gaming layer
// - set up play/pause/skip (shift behavior for arrow keys?)
// - reconfigure tab:
//      - single click: math layer tap
//      - single hold: math layer hold
//      - double tap: symbol layer tap
//      - double hold: symbol layer hold

// Reference for binding behaviour keywords:
// &kp: keypress
// &none: no signal
// &trans: inherit signal from base layer
// &lt: (layer tap) for hold tap behaviors with custom layer changes (Mac, Symbol, etc)
// &ht: (custom hold tap) for hold tap behaviors with modal changes (control, alt, shift, etc)
// &sk: (sticky key) allows double-tab for sticky behavior
// &mo: (momentary layer) changes layer while key is pressed

#define MAC 0
#define WIN 1
#define GAME 2
#define MATH 3
#define SYMB 4
#define FUNC 5
#define CONF 6
#define LOCK 7

// convenience method to define tap, hold, double-tap hold behavior

// #define TAP_DANCE_DOUBLE_TAP_HOLD(code, press1, press2) \
// dth_##code: code { \
//     compatible = "zmk,behavior-tap-dance"; \
//     label = ###code; \
//     #binding-cells = <0>; \
//     bindings = <press1>, <press2>; \
//     tapping-term-ms = <120>; \
// };
// example:
// TAP_DANCE_DOUBLE_TAP_HOLD(thumb1, &ht_hp LGUI ESC, &ht_hp LCTRL ESC)

// convenience partial to reuse hold tap behavior

#define HOLD_TAP_PARTIAL \
    compatible = "zmk,behavior-hold-tap"; \
    #binding-cells = <2>; \
    tapping-term-ms = <220>; \
    quick-tap-ms = <150>; \
    global-quick-tap;

#define HRML(k1,k2,k3,k4,k5) \
    &ht_tp LGUI k1 \
    &ht_tp LALT k2 \
    &ht_tp LSHFT k3 \
    &ht_tp LCTRL k4 \
    &ht_hp_layer LOCK k5

#define HRMR(k1,k2,k3,k4,k5) \
    &ht_hp_layer LOCK k1 \
    &ht_tp RCTRL k2 \
    &ht_tp RSHFT k3 \
    &ht_tp RALT k4 \
    &ht_tp RGUI k5

&caps_word {
    continue-list = <UNDERSCORE MINUS BACKSPACE DELETE>;
};

/ {
    combos {
        compatible = "zmk,combos";

        // use vim's jk combo for escape
        combo_esc_1 {
            timeout-ms = <50>;
            key-positions = <19 20>; // j and k positions
            bindings = <&kp ESC>;
        };
        combo_esc_2 {
            timeout-ms = <50>;
            key-positions = <1 2>; // q and w
            bindings = <&kp ESC>;
        };

        // Returns to base mac layer if we are stuck 
        combo_return_to_base {
            timeout-ms = <50>;
            key-positions = <1 13 25>; // q, a, z
            bindings = <&to MAC>;
        };

        combo_double_middle_thumb {
            timeout-ms = <50>;
            key-positions = <37 40>; 
            bindings = <&caps_word>;
        };

        combo_cut {
            timeout-ms = <50>;
            key-positions = <14 15>; 
            bindings = <&kp LG(X)>;
        };

        combo_copy {
            timeout-ms = <50>;
            key-positions = <15 16>; 
            bindings = <&kp LG(C)>;
        };

        combo_paste {
            timeout-ms = <50>;
            key-positions = <16 17>; 
            bindings = <&kp LG(V)>;
        };
    };

    macros {
        back_dir: back_dir {
            compatible = "zmk,behavior-macro";
            #binding-cells = <0>;
            label = "back_dir";
            bindings = <&macro_tap &kp DOT &kp DOT &kp FSLH>; 
        };
    };

    behaviors {

        ht_st: hold_tap_with_sticky_layer {
            label = "hold_tap_with_sticky_layer";
            flavor = "hold-preferred";
            bindings = <&kp>, <&sl>;
            HOLD_TAP_PARTIAL
        };

        ht_tp: hold_tap_tap_preferred {
            label = "hold_tap_tap_preferred";
            flavor = "tap-preferred";
            bindings = <&kp>, <&kp>;
            HOLD_TAP_PARTIAL
        };

        ht_tp_layer: hold_tap_tap_preferred_layer {
            label = "hold_tap_tap_preferred_layer";
            flavor = "tap-preferred";
            bindings = <&mo>, <&kp>;
            HOLD_TAP_PARTIAL
        };

        ht_hp: hold_tap_hold_preferred {
            label = "hold_tap_hold_preferred";
            flavor = "hold-preferred";
            bindings = <&kp>, <&kp>;
            HOLD_TAP_PARTIAL
        };

        ht_hp_layer: hold_tap_hold_preferred_layer {
            label = "hold_tap_hold_preferred_layer";
            flavor = "hold-preferred";
            bindings = <&mo>, <&kp>;
            HOLD_TAP_PARTIAL
        };

        // special hold_tap for the backspace_delete behavior
        // https://www.reddit.com/r/zmk/comments/12ujlmb/combing_modmorph_and_layer_tap/

        ht_bspc: hold_tap_backspace_delete {
            label = "hold_tap_backspace_delete";
            flavor = "hold-preferred";
            bindings = <&mo>, <&bspc_del>;
            HOLD_TAP_PARTIAL
        };

        // convert backspace to delete with shift

        bspc_del: backspace_delete {
            compatible = "zmk,behavior-mod-morph";
            label = "BACKSPACE_DELETE";
            #binding-cells = <0>;
            bindings = <&kp BACKSPACE>, <&kp DELETE>;
            mods = <(MOD_LSFT|MOD_RSFT)>;
        };
    };

    // this tri-layer will toggle the config layer if MATH and SYMB are toggled.
    // requiring 2 keys might prevent accidental triggers.
    conditional_layers {
        compatible = "zmk,conditional-layers";
        tri_layer {
            if-layers = <MATH SYMB>;
            then-layer = <CONF>;
        };
    };

    keymap {
        compatible = "zmk,keymap";
        
        // 0 BASE -- MAC
        mac {
            label = "Mac";
            bindings = <
                &none  &kp Q  &kp W &kp E  &kp R  &kp T  &kp Y  &kp U  &kp I  &kp O  &kp P  &none
                &none  HRML(A, S, D, F, G)  HRMR(H, J, K, L, SEMI)  &none
                &none  &ht_tp_layer FUNC Z  &kp X  &kp C  &kp V  &kp B  &kp N  &kp M  &kp COMMA  &kp DOT  &ht_tp_layer FUNC SQT &none
                &ht_st LGUI SYMB  &ht_hp LSHFT SPACE  &lt MATH TAB  &lt MATH RET &sk RSHIFT &ht_bspc SYMB 0
            >;
        };

        // 1 BASE -- WIN;
        win {
            label = "Windows";
            bindings = <
                &none  &ht_tp LGUI Q  &kp W &kp E  &kp R  &kp T  &kp Y  &kp U  &kp I  &kp O  &ht_tp RGUI P  &none
                &none  &lt FUNC A  &kp S  &kp D  &kp F  &lt SYMB G  &lt SYMB H  &kp J  &kp K  &kp L  &lt FUNC SQT &none
                &none  &ht_tp LALT Z  &kp X  &kp C  &kp V  &kp B  &kp N  &kp M  &kp COMMA  &kp DOT  &ht_tp LALT FSLH &none
                &ht_hp LCTRL ESC  &ht_hp LSHFT SPACE  &lt SYMB TAB  &lt SYMB RET &sk RSHIFT &ht_bspc RCTRL 0 
            >;
        };

        // 2 BASE -- GAME
        game {
            label = "Game";
            bindings = <
                &kp ESC  &kp Q  &kp W &kp E  &kp R  &kp T  &kp Y  &kp U  &kp I  &kp O  &kp P  &bspc_del 
                &mo FUNC  &kp A  &kp S  &kp D  &kp F  &lt SYMB G  &lt SYMB H  &kp J  &kp K  &kp L  &kp SQT &mo FUNC
                &mo MATH  &kp Z  &kp X  &kp C  &kp V  &kp B  &kp N  &kp M  &kp COMMA  &kp DOT  &kp FSLH &mo MATH
                &kp LCTRL &kp SPACE  &kp TAB  &kp RET  &kp RSHIFT  &kp RCTRL
            >;
        };

        // 3 MOD -- MATH
        math {
            label = "Math";
            bindings = <
                &none  &none  &none  &none  &none  &kp DLLR  &kp FSLH  &kp KP_N7  &kp KP_N8  &kp KP_N9  &kp KP_MINUS  &none
                &none  &none  &kp MINUS  &kp PLUS  &kp EQUAL  &mo LOCK  &lt LOCK ASTRK  &kp KP_N4  &kp KP_N5  &kp KP_N6  &kp KP_PLUS  &none
                &none  &kp CARET  &kp FSLH  &kp ASTRK  &none  &none  &none  &kp KP_N1  &kp KP_N2  &kp KP_N3  &kp KP_ENTER  &none
                &trans  &trans  &tog MATH  &tog MATH  &kp KP_DOT  &lt SYMB KP_N0
            >;
        };

        // 4 MOD -- SYMBOL
        symbolic {
            label = "Symbol";
            bindings = <
                &none  &kp GRAVE  &kp LT  &kp GT  &kp HASH  &back_dir  &kp TILDE  &kp AMPS  &kp LBKT  &kp RBKT  &kp PRCNT  &none
                &none  &kp EXCL  &kp MINUS  &kp PLUS  &kp EQUAL  &lt LOCK UNDER  &mo LOCK  &kp PIPE  &kp LPAR  &kp RPAR  &kp QMARK  &none
                &none  &kp CARET  &kp FSLH  &kp ASTRK  &kp BSLH  &none  &none  &kp DLLR  &kp LBRC  &kp RBRC  &kp AT  &none
                &tog SYMB  &none  &none  &none  &none  &tog SYMB
            >;
        };

        // 5 MOD -- FUNC
        func {
            // f3 (expose) duplicated in top left
            // f19 used for MEH key
            label = "Function";
            bindings = <
                &none  &kp F3  &kp F7  &kp F8  &kp F9  &kp F12  &kp C_BRI_DN  &kp C_BRI_UP  &kp K_MUTE  &kp K_VOL_DN &kp K_VOL_UP &none
                &none  &kp F19  &kp F4  &kp F5  &kp F6  &kp F11  &kp LEFT &kp DOWN &kp UP &kp RIGHT &kp INSERT &none
                &none  &trans  &kp F1  &kp F2  &kp F3  &kp F10  &kp HOME  &kp PAGE_DOWN  &kp PAGE_UP  &kp END &trans &none
                &trans  &trans  &trans  &trans  &trans  &trans 
            >;
        };

        // 6 MOD -- CONF
        conf {
            label = "Config";
            bindings = <
                &none  &to MAC  &to WIN  &to GAME  &none  &none  &bt BT_CLR &none  &none  &none  &none  &none
                &none  &none  &none  &none  &none  &mo LOCK  &mo LOCK  &none  &none  &none  &none  &none
                &none  &none  &none  &none  &none  &none  &bt BT_SEL 0  &bt BT_SEL 1  &bt BT_SEL 2  &bt BT_SEL 3  &bt BT_SEL 4  &none
                &tog CONF  &tog CONF  &tog CONF  &tog CONF  &tog CONF  &tog CONF 
            >;
        };

        // 7 MOD -- Lock
        lock {
            label = "Lock";
            bindings = <
                &none  &none  &none  &none  &none  &none  &none  &none  &none  &none  &none  &none
                &none  &none  &none  &none  &none  &none  &none  &none  &none  &none  &none  &none
                &none  &none  &none  &none  &none  &none  &none  &none  &none  &none  &none  &none
                &tog SYMB  &none  &tog MATH  &tog MATH  &none  &tog SYMB
            >;
        };

    };
};
